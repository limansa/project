// Definitions for MCP3008 ADC
// www.ittraining.com.tw
/dts-v1/;
/plugin/;

/ {
    compatible = "brcm,bcm2835", "brcm,bcm2708";
    /* disable spi-dev for spi0.0 */
    fragment@0 {
        target = <&spi0>;
        __overlay__ {
            status = "okay";
            spidev@0{
                status = "disabled";
            };
        };
    };

    fragment@1 {
        target = <&spi0>;
        __overlay__ {
            /* needed to avoid dtc warning */
            #address-cells = <1>;
            #size-cells = <0>;
            spiflash@0 {
                compatible = "mx25l4005a";
                reg = <0>;
                spi-max-frequency = <1000000>;
            };
        };
    };
};